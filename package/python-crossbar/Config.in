## package/python-crossbar/Config.in
```kconfig
config BR2_PACKAGE_PYTHON_CROSSBAR
	bool "python-crossbar"
	depends on BR2_PACKAGE_HOST_RUSTC_TARGET_ARCH_SUPPORTS # python-cryptography
	depends on BR2_PACKAGE_PYTHON3
	# All the following dependencies are runtime dependencies
	select BR2_PACKAGE_PYTHON_AUTOBAHN
	select BR2_PACKAGE_PYTHON_AUTOBAHN_ACCELERATE
	select BR2_PACKAGE_PYTHON_AUTOBAHN_COMPRESS
	select BR2_PACKAGE_PYTHON_AUTOBAHN_ENCRYPTION
	select BR2_PACKAGE_PYTHON_AUTOBAHN_SCRAM
	select BR2_PACKAGE_PYTHON_AUTOBAHN_SERIALIZATION
	select BR2_PACKAGE_PYTHON_AUTOBAHN_TWISTED
	select BR2_PACKAGE_PYTHON_BITSTRING
	select BR2_PACKAGE_PYTHON_CBOR
	select BR2_PACKAGE_PYTHON_CLICK
	select BR2_PACKAGE_PYTHON_COLORAMA
	select BR2_PACKAGE_PYTHON_CRYPTOGRAPHY
	select BR2_PACKAGE_PYTHON_JINJA2
	select BR2_PACKAGE_PYTHON_LMDB
	select BR2_PACKAGE_PYTHON_MISTUNE
	select BR2_PACKAGE_PYTHON_PASSLIB
	select BR2_PACKAGE_PYTHON_PRIORITY
	select BR2_PACKAGE_PYTHON_PSUTIL
	select BR2_PACKAGE_PYTHON_PYASN1
	select BR2_PACKAGE_PYTHON_PYASN1_MODULES
	select BR2_PACKAGE_PYTHON_PYGMENTS
	select BR2_PACKAGE_PYTHON_PYNACL
	select BR2_PACKAGE_PYTHON_PYOPENSSL
	select BR2_PACKAGE_PYTHON_PYQRCODE
	select BR2_PACKAGE_PYTHON_PYTRIE
	select BR2_PACKAGE_PYTHON_PYYAML
	select BR2_PACKAGE_PYTHON_SDNOTIFY
	select BR2_PACKAGE_PYTHON_SETPROCTITLE
	select BR2_PACKAGE_PYTHON_SETUPTOOLS
	select BR2_PACKAGE_PYTHON_TREQ
	select BR2_PACKAGE_PYTHON_TWISTED
	select BR2_PACKAGE_PYTHON_TWISTED_CONCH
	select BR2_PACKAGE_PYTHON_TWISTED_HTTP2
	select BR2_PACKAGE_PYTHON_TWISTED_TLS
	select BR2_PACKAGE_PYTHON_TXAIO
	select BR2_PACKAGE_PYTHON_TXTORCON
	select BR2_PACKAGE_PYTHON_WATCHDOG
	select BR2_PACKAGE_PYTHON_WERKZEUG
	select BR2_PACKAGE_PYTHON_ZLMDB
	select BR2_PACKAGE_PYTHON_ZOPE_INTERFACE
	help
	  Crossbar.io is an open-source WAMP application router that
	  allows to build advanced applications from loosely-coupled
	  components that can talk in real-time with each other.

	  https://pypi.python.org/pypi/crossbar
```

## package/python-zlmdb/Config.in
```kconfig
config BR2_PACKAGE_PYTHON_ZLMDB
	bool "python-zlmdb"
	select BR2_PACKAGE_PYTHON_CBOR2 # runtime
	select BR2_PACKAGE_PYTHON_CFFI # runtime
	select BR2_PACKAGE_PYTHON_CLICK # runtime
	select BR2_PACKAGE_PYTHON_FLATBUFFERS # runtime
	select BR2_PACKAGE_PYTHON_LMDB # runtime
	select BR2_PACKAGE_PYTHON_NUMPY # runtime
	select BR2_PACKAGE_PYTHON_PYNACL # runtime
	select BR2_PACKAGE_PYTHON_PYYAML # runtime
	select BR2_PACKAGE_PYTHON_TXAIO # runtime
	help
	  Object-relational zero-copy in-memory database layer for
	  LMDB.

	  https://github.com/crossbario/zlmdb
```
